## meta-project/conf/distro/Tic-Tac-Toe.conf
```bitbake
include meta-poky/conf/distro/poky.conf

DISTRO = "Tic-Tac-Toe"
DISTRO_NAME = "Tic-Tac-Toe"
#DISTRO_VERSION = "3.4+snapshot-${METADATA_REVISION}"
DISTRO_VERSION = "4.0.20"
DISTRO_CODENAME = "kirkstone"




IMAGE_INSTALL:append = " dropbear systemd systemd-serialgetty "

MAINTAINER = "abdoabo3lm@gmail.com"

Aboalam_DEFAULT_DISTRO_FEATURES = "largefile opengl ptest multiarch wayland vulkan ssh wifi x11"

DISTRO_FEATURES ?= "${DISTRO_FEATURES_DEFAULT} ${Aboalam_DEFAULT_DISTRO_FEATURES}"
```
